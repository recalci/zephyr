## boards/wch/ch641evt/Kconfig.ch641evt
```kconfig
# Copyright (c) 2024 Jianxiong Gu <jianxiong.gu@outlook.com>
# SPDX-License-Identifier: Apache-2.0

config BOARD_CH641EVT
	select SOC_CH641
```

## boards/wch/ch641evt/board.yml
```yaml
board:
  name: ch641evt
  full_name: WCH CH641EVT
  vendor: wch
  socs:
    - name: ch641
```

## boards/wch/ch641evt/ch641evt_defconfig
```kconfig
# Copyright (c) 2024 Jianxiong Gu <jianxiong.gu@outlook.com>
# SPDX-License-Identifier: Apache-2.0

CONFIG_GPIO=y

CONFIG_SERIAL=y
CONFIG_CONSOLE=y
CONFIG_UART_CONSOLE=y
```

## soc/wch/ch32v/Kconfig.defconfig
```kconfig
# Copyright (c) 2024 Michael Hope
# SPDX-License-Identifier: Apache-2.0

if SOC_FAMILY_CH32V

rsource "*/Kconfig.defconfig"

endif # SOC_FAMILY_CH32V
```

## soc/wch/ch32v/Kconfig.soc
```kconfig
# Copyright (c) 2024 Michael Hope
# SPDX-License-Identifier: Apache-2.0

config SOC_FAMILY_CH32V
	bool

config SOC_FAMILY
	default "ch32v" if SOC_FAMILY_CH32V

rsource "*/Kconfig.soc"
```

## soc/wch/ch32v/qingke_v2a/Kconfig.defconfig.ch641
```kconfig
# Copyright (c) 2024 Jianxiong Gu <jianxiong.gu@outlook.com>
# SPDX-License-Identifier: Apache-2.0

if SOC_CH641

config VECTOR_TABLE_SIZE
	default 40

config NUM_IRQS
	default 59

endif # SOC_CH641
```

## soc/wch/ch32v/qingke_v2a/Kconfig.soc.ch641
```kconfig
# Copyright (c) 2024 Jianxiong Gu <jianxiong.gu@outlook.com>
# SPDX-License-Identifier: Apache-2.0

config SOC_CH641
	bool
	select SOC_SERIES_QINGKE_V2A

config SOC
	default "ch641" if SOC_CH641
```
