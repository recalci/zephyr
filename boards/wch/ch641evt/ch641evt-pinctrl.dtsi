/*
 * Copyright (c) 2024 Jianxiong Gu <jianxiong.gu@outlook.com>
 * SPDX-License-Identifier: Apache-2.0
 */

#include <zephyr/dt-bindings/pinctrl/ch641-pinctrl.h>

&pinctrl {
	usart1_default: usart1_default {
		group1 {
			pinmux = <USART1_TX_PA0_2>;
			output-high;
			drive-push-pull;
			slew-rate = "max-speed-10mhz";
		};
		group2 {
			pinmux = <USART1_RX_PA1_2>;
			bias-pull-up;
		};
	};
};
