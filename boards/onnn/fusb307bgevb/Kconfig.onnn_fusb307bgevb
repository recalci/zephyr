## boards/onnn/fusb307bgevb/Kconfig.onnn_fusb307bgevb
```kconfig
# Copyright (c) 2024 Jianxiong Gu <jianxiong.gu@outlook.com>
# SPDX-License-Identifier: Apache-2.0

config BOARD_ONNN_FUSB307BGEVB
	select SOC_STM32F072XB
```

## boards/onnn/fusb307bgevb/onnn_fusb307bgevb_defconfig
```kconfig
# SPDX-License-Identifier: Apache-2.0

# Serial Drivers
CONFIG_SERIAL=y
CONFIG_UART_INTERRUPT_DRIVEN=y

# Enable Console
CONFIG_CONSOLE=y
CONFIG_UART_CONSOLE=y

# Enable Clocks
CONFIG_CLOCK_CONTROL=y

# Enable Logger
CONFIG_LOG=y

# Enable Pin Controller
CONFIG_PINCTRL=y

# Enable GPIO
CONFIG_GPIO=y

# Enable FUSB307 GPIO
# CONFIG_GPIO_FUSB307=y
```

## boards/weact/bluepill_ch32v203/Kconfig.bluepill_ch32v203
```kconfig
# Copyright (c) 2024 MASSDRIVER EI (massdriver.space)
# SPDX-License-Identifier: Apache-2.0

config BOARD_BLUEPILL_CH32V203
	select SOC_CH32V203
```

## boards/weact/bluepill_ch32v203/board.yml
```yaml
board:
  name: bluepill_ch32v203
  full_name: WeAct Studio Blue Pill Plus V1.1 (CH32V203)
  vendor: weact
  socs:
    - name: ch32v203
```

## drivers/gpio/Kconfig.fusb307
```kconfig
# Copyright (c) 2025 Jianxiong Gu <jianxiong.gu@outlook.com>
# SPDX-License-Identifier: Apache-2.0

menuconfig GPIO_FUSB307
	bool "ON Semiconductor FUSB307 GPIO support"
	default y
	depends on DT_HAS_ONNN_FUSB307_GPIO_ENABLED
	select MFD
	help
	  Enable GPIO driver for the FUSB307.

config GPIO_FUSB307_INIT_PRIORITY
	int "FUSB307 GPIO init priority"
	default 71
	depends on GPIO_FUSB307
	help
	  Initialization priority for the FUSB307 GPIO driver. This priority
	  should be lower than MFD_FUSB307_INIT_PRIORITY.
```

## drivers/mfd/Kconfig.fusb307
```kconfig
# Copyright (c) 2025 Jianxiong Gu <jianxiong.gu@outlook.com>
# SPDX-License-Identifier: Apache-2.0

menuconfig MFD_FUSB307
	bool "ON Semiconductor FUSB307 TCPC/GPIO chip"
	default y
	depends on DT_HAS_ONNN_FUSB307_ENABLED
	select I2C
	help
	  Enable support for the ON Semiconductor FUSB307 driver.

config MFD_FUSB307_INIT_PRIORITY
	int "Init priority"
	default 70
	depends on MFD_FUSB307
	help
	  Device driver initialization priority. The priority should be lower than I2C.
```

## drivers/usb/bc12/Kconfig
```kconfig
# Copyright (c) 2022 Google LLC
# SPDX-License-Identifier: Apache-2.0

menuconfig USB_BC12
	bool "USB BC1.2 Drivers"
	help
	  Enable USB BC1.2 (battery charging detection) drivers.

if USB_BC12

config USB_BC12_INIT_PRIORITY
	int "USB BC1.2 driver init priority"
	default 81
	help
	  Initialization priority of the USB BC1.2 drivers in POST_KERNEL.

module = USB_BC12
module-str = usb_bc12
source "subsys/logging/Kconfig.template.log_config"

source "drivers/usb/bc12/Kconfig.pi3usb9201"
source "drivers/usb/bc12/Kconfig.ch32v"

endif # USB_BC12
```

## drivers/usb/bc12/Kconfig.ch32v
```kconfig
# Copyright (c) 2025 Jianxiong Gu
# SPDX-License-Identifier: Apache-2.0

config USB_BC12_CH32V
	bool "CH32V USB BC1.2 driver"
	depends on DT_HAS_WCH_CH32V_BC12_ENABLED
	help
	  Enable USB BC1.2 support on the WCH RISC-V Qingke Series of
	  processors. It can operate in portable device mode. It starts
	  BC1.2 detection to detect the attached host type.
```

## dts/bindings/gpio/onnn,fusb307-gpio.yaml
```yaml
# Copyright (c) 2025 Jianxiong Gu <jianxiong.gu@outlook.com>
# SPDX-License-Identifier: Apache-2.0

description: |
    Onsemi FUSB307 TCPC chip GPIO port

include: [gpio-controller.yaml, base.yaml]

compatible: "onnn,fusb307-gpio"

properties:
  "#gpio-cells":
    const: 2

  ngpios:
    type: int
    required: true
    const: 3
    description: |
      Number of GPIOs available on port expander.

  gpio-reserved-ranges:
    required: true
    const: [0, 1]
    description: |
      Ranges of GPIOs reserved unavailable on port expander.
      The FUSB307 has 2 GPIO. GPIO number0 is reserved.

gpio-cells:
  - pin
  - flags
```

## dts/bindings/mfd/onnn,fusb307.yaml
```yaml
# Copyright (c) 2025 Jianxiong Gu <jianxiong.gu@outlook.com>
# SPDX-License-Identifier: Apache-2.0

description: |
    Onsemi FUSB307 TCPC chip, also provides VBUS measurement and 2 GPIOs.

compatible: "onnn,fusb307"

include: i2c-device.yaml

properties:
  irq-gpios:
    type: phandle-array
    required: true
    description: Interrupt GPIO pin connected from the chip
```

## soc/wch/ch32v/qingke_v4b/Kconfig.soc
```kconfig
# Copyright (c) 2025 Jianxiong Gu <jianxiong.gu@outlook.com>
# SPDX-License-Identifier: Apache-2.0

config SOC_SERIES_QINGKE_V4B
	bool
	select SOC_FAMILY_CH32V

config SOC_SERIES
	default "qingke_v4b" if SOC_SERIES_QINGKE_V4B

rsource "Kconfig.soc.*"
```

## soc/wch/ch32v/qingke_v4b/Kconfig.soc.ch32v203
```kconfig
# Copyright (c) 2025 Jianxiong Gu <jianxiong.gu@outlook.com>
# SPDX-License-Identifier: Apache-2.0

config SOC_CH32V203
	bool
	select SOC_SERIES_QINGKE_V4B

config SOC_CH32V203RB
	bool
	select SOC_SERIES_QINGKE_V4B

config SOC
	default "ch32v203rb" if SOC_CH32V203RB
	default "ch32v203"
```

## subsys/usb/charge_protocol/bc12/Kconfig
```kconfig
# Copyright (c) 2025 Jianxiong Gu
# SPDX-License-Identifier: Apache-2.0

menuconfig USB_CHARGE_PROTOCOL_BC12
	bool "USB BC1.2 Support"
	select SMF
	help
	  Enable the USB BC1.2. Note that each USB port gets its own thread.

if USB_CHARGE_PROTOCOL_BC12

config USB_BC12_STATE_MACHINE_CYCLE_TIME
	int "BC1.2 state machine cycle time in milliseconds"
	default 5
	help
	  The BC1.2 state machine is run in a loop and the cycle time is the
	  delay before running the loop again.

choice USB_BC12_ROLE
	prompt "USB BC1.2 State Machine"
	default USB_BC12_PD_ONLY

config USB_BC12_PD_ONLY
	bool "USB BC1.2 Portable Device State Machine"
	help
	  Allows the USB BC1.2 state machine to function as a Portable Device.

endchoice

module = USB_BC12
module-str = usb bc12
source "subsys/logging/Kconfig.template.log_config"

endif # USB_CHARGE_PROTOCOL_BC12
```
