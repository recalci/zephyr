/*
 * Copyright (c) 2024 Michael Hope
 *
 * SPDX-License-Identifier: Apache-2.0
 */

#include <wch/ch32v0/ch32v003.dtsi>

/ {
	soc {
		pinctrl: pin-controller@40010000 {
			gpioa: gpio@40010800 {
				gpio-reserved-ranges = <0 1>, <3 5>;
			};
		};
	};
};
