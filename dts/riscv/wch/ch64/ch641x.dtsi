/*
 * Copyright (c) 2024 Jianxiong Gu <jianxiong.gu@outlook.com>
 *
 * SPDX-License-Identifier: Apache-2.0
 */

#include <wch/ch64/ch641.dtsi>

&gpioa {
	gpio-reserved-ranges = <8 3>, <13 3>;
};

&gpiob {
	gpio-reserved-ranges = <2 1>, <5 2>, <10 6>;
};
