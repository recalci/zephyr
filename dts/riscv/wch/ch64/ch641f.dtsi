/*
 * Copyright (c) 2024 Jianxiong Gu <jianxiong.gu@outlook.com>
 *
 * SPDX-License-Identifier: Apache-2.0
 */

#include <wch/ch64/ch641.dtsi>

/ {
	soc {
		pinctrl: pin-controller@40010000 {
			gpiob: gpio@40010c00 {
				gpio-reserved-ranges = <6 1>, <10 6>;
			};
		};
	};
};
