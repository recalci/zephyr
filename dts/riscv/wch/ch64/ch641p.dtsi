/*
 * Copyright (c) 2024 Jianxiong Gu <jianxiong.gu@outlook.com>
 *
 * SPDX-License-Identifier: Apache-2.0
 */

#include <wch/ch64/ch641.dtsi>

&gpioa {
	gpio-reserved-ranges = <3 1>, <5 1>, <8 8>;
};

&gpiob {
	gpio-reserved-ranges = <2 1>, <5 2>, <10 6>;
};
